## Kconfig.projbuild
```kconfig
menu "ESP Config lib settings"

choice LOG_LOCAL_LEVEL_CONFIG
    bool "CONFIG log verbosity"
    default LOG_LOCAL_LEVEL_CONFIG_INFO
    help
        Specify how much output to compile into the binary.
        You can set lower verbosity level at runtime using
        esp_log_level_set function.

        Note that this setting limits which log statements
        are compiled into the program in sources. So
        setting this to, say, "Warning" would mean that
        changing log level to "Debug" at runtime will not
        be possible.

    config LOG_LOCAL_LEVEL_CONFIG_NONE
        bool "No output"
    config LOG_LOCAL_LEVEL_CONFIG_ERROR
        bool "Error"
    config LOG_LOCAL_LEVEL_CONFIG_WARN
        bool "Warning"
    config LOG_LOCAL_LEVEL_CONFIG_INFO
        bool "Info"
    config LOG_LOCAL_LEVEL_CONFIG_DEBUG
        bool "Debug"
    config LOG_LOCAL_LEVEL_CONFIG_VERBOSE
        bool "Verbose"
endchoice

config LOG_LOCAL_LEVEL_CONFIG
    int
    default 0 if LOG_LOCAL_LEVEL_CONFIG_NONE
    default 1 if LOG_LOCAL_LEVEL_CONFIG_ERROR
    default 2 if LOG_LOCAL_LEVEL_CONFIG_WARN
    default 3 if LOG_LOCAL_LEVEL_CONFIG_INFO
    default 4 if LOG_LOCAL_LEVEL_CONFIG_DEBUG
    default 5 if LOG_LOCAL_LEVEL_CONFIG_VERBOSE

config SEPARATE_FACTORY_NVS_PARTITION
    bool "Separate factory nvs partition (for easy erasure of user settings)"
    default y

endmenu
```
